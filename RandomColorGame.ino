//libraries:
#include <Adafruit_CircuitPlayground.h>
#include <AsyncDelay.h>
#include <Talkie.h>

//variables:
int lrandlight; 
int rrandlight; 
volatile int userr = 0; 
volatile int userl = 9; 
int colorr; 
int colorg; 
int colorb; 
int score; 
volatile int gametime=5000; 
volatile bool lactuation =0; 
volatile bool ractuation =0; 
AsyncDelay tImer;
Talkie voice;

//spoken word data:
const uint8_t spLEVEL[] PROGMEM = {0x69,0xAB,0xC4,0xB3,0xD8,0x92,0x86,0x2D,0x83,0xEE,0x60,0xCD,0x12,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0xF9,0x7F};
const uint8_t spZERO[] PROGMEM = {0x69,0xFB,0x59,0xDD,0x51,0xD5,0xD7,0xB5,0x6F,0x0A,0x78,0xC0,0x52,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0xFF,0x1F};
const uint8_t spONE[] PROGMEM = {0x66,0x4E,0xA8,0x7A,0x8D,0xED,0xC4,0xB5,0xCD,0x89,0xD4,0xBC,0xA2,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0xFE,0x1F};
const uint8_t spTWO[]  PROGMEM = {0x06,0xB8,0x59,0x34,0x00,0x27,0xD6,0x38,0x60,0x58,0xD3,0x91,0x55,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0xFF,0x1F};
const uint8_t spTHREE[] PROGMEM = {0x0C,0xE8,0x2E,0x94,0x01,0x4D,0xBA,0x4A,0x40,0x03,0x16,0x68,0x69,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0xFF,0x03};
const uint8_t spFOUR[] PROGMEM = {0x08,0x68,0x21,0x0D,0x03,0x1C,0x90,0xC0,0x88,0x92,0xB2,0x29,0x87,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0xFC,0x3F};
const uint8_t spFIVE[] PROGMEM = {0x08,0x68,0x4E,0x9D,0x02,0x1C,0x60,0xC0,0x8C,0x69,0x12,0xB0,0xC0,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0xFF,0x01};
const uint8_t spSIX[] PROGMEM = {0x04,0xF8,0xB9,0x55,0x01,0xBF,0xA5,0x1B,0xE0,0x37,0x0F,0x03,0xFC,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0xFC,0x3F};
const uint8_t spSEVEN[] PROGMEM = {0x0C,0x78,0xC6,0x95,0x01,0x3F,0xA5,0x28,0xE0,0xB7,0x52,0x0B,0x04,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0xFF,0x07};
const uint8_t spEIGHT[] PROGMEM = {0xAD,0x1B,0xDE,0x58,0x23,0x17,0xAF,0x6E,0xE8,0x20,0xEB,0x5C,0xBC,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0xFF,0x0F};
const uint8_t spNINE[] PROGMEM = {0x62,0x75,0xDC,0x33,0xB5,0x62,0xB9,0x25,0x0B,0x8E,0x34,0x8F,0xD3,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0xFF,0x03};
const uint8_t spTEN[] PROGMEM = {0x0A,0xD8,0x5C,0x4D,0x03,0x2B,0xAB,0x5E,0xC4,0x33,0x2B,0xAF,0x62,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0xFD,0x7F};
const uint8_t spELEVEN[] PROGMEM = {0x29,0x6F,0x52,0xA8,0xBB,0x6A,0x8F,0xBA,0x2B,0xC5,0xE8,0x9C,0xBD,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0xF4,0xFF};
const uint8_t spTWELVE[] PROGMEM = {0x09,0x98,0xDA,0x22,0x01,0x37,0x78,0x1A,0x20,0x85,0xD1,0x50,0x3A,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0xFE,0x1F};
const uint8_t spTHIRTEEN[] PROGMEM = {0x08,0x18,0xA2,0x12,0x03,0x18,0x40,0xC0,0x50,0x13,0x25,0x1D,0x3A,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0xFC,0x7F};
const uint8_t spFOURTEEN[] PROGMEM = {0x08,0xE8,0x2A,0x94,0x00,0xC3,0x56,0x10,0x60,0xFA,0x0A,0x01,0x4C,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0xFF,0x0F};
const uint8_t spFIFTEEN[] PROGMEM = {0x02,0x68,0xD6,0xCC,0x00,0x43,0x9A,0x39,0x60,0x3A,0xF7,0x51,0x34,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0xFF,0x0F};
const uint8_t spSIXTEEN[] PROGMEM = {0x0C,0x78,0xC6,0x95,0x01,0x3F,0xA5,0x28,0xE0,0xB7,0x52,0x0B,0x04,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0xFF,0x1F};
const uint8_t spSEVENTEEN[] PROGMEM = {0x0C,0xF8,0x29,0x45,0x01,0xBF,0x95,0x5A,0x20,0x00,0xBF,0xA5,0x3A,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0xFE,0x1F};
const uint8_t spEIGHTEEN[] PROGMEM = {0x6B,0x18,0x36,0x88,0x3B,0x1B,0xEF,0x61,0x0D,0xD3,0x27,0x52,0xE5,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0xFF,0x01};
const uint8_t spNINETEEN[] PROGMEM = {0x6E,0x2F,0x44,0xB4,0x5B,0x93,0xA6,0xAD,0x32,0x96,0x2E,0x69,0xBA,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0xFF,0x0F};
const uint8_t spTWENTY[] PROGMEM = {0x0A,0xE8,0x4A,0xCD,0x01,0xDB,0xB9,0x33,0xC0,0xA6,0x54,0x0C,0xA4,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0xFF,0x1F};

//functions:
void randomcolors(){//random color light generating function
  colorr = random(255); //chose random red value
  colorg = random(255); //chose random green value
  colorb = random(255); //chose random blue value
  lrandlight = random(4)+5; //choose random position on left half of board
  rrandlight = random(4)+1; //choose random position on right half of board
  CircuitPlayground.setPixelColor(lrandlight, colorr, colorg, colorb); //display left random light
  CircuitPlayground.setPixelColor(rrandlight, colorr, colorg, colorb); //display right random light
}
void breathing(){//loosing color pattern
  for(int i=0; i<2; i++){
    for(int i=0;i<255;i++)
    {
    CircuitPlayground.setPixelColor(1, i, 0, 0);
    CircuitPlayground.setPixelColor(2, i, 0, 0);
    CircuitPlayground.setPixelColor(3, i, 0, 0);
    CircuitPlayground.setPixelColor(4, i, 0, 0);
    CircuitPlayground.setPixelColor(5, i, 0, 0);
    CircuitPlayground.setPixelColor(6, i, 0, 0);
    CircuitPlayground.setPixelColor(7, i, 0, 0);
    CircuitPlayground.setPixelColor(8, i, 0, 0);
    CircuitPlayground.setPixelColor(9, i, 0, 0);
    CircuitPlayground.setPixelColor(0, i, 0, 0);
    }
    tImer.repeat();
    for(int i=255;i>0;i--)
    {
    CircuitPlayground.setPixelColor(1, i, 0, 0);
    CircuitPlayground.setPixelColor(2, i, 0, 0);
    CircuitPlayground.setPixelColor(3, i, 0, 0);
    CircuitPlayground.setPixelColor(4, i, 0, 0);
    CircuitPlayground.setPixelColor(5, i, 0, 0);
    CircuitPlayground.setPixelColor(6, i, 0, 0);
    CircuitPlayground.setPixelColor(7, i, 0, 0);
    CircuitPlayground.setPixelColor(8, i, 0, 0);
    CircuitPlayground.setPixelColor(9, i, 0, 0);
    CircuitPlayground.setPixelColor(0, i, 0, 0);
    }
    tImer.repeat();
  }
}
void singlePressl() {//left button flag
  lactuation = 1;
}
void singlePressr() {//right button flag
  ractuation = 1;
}
void loose(){//losing function
  CircuitPlayground.clearPixels(); //turnoff all pixels
  score=(5000-gametime)/250; //evaluate score based on gametime
  CircuitPlayground.speaker.say(spLEVEL); // say "level"
  switch(score){// say "[score value]"
    case 0: CircuitPlayground.speaker.say(spZERO);
    break;
    case 1: CircuitPlayground.speaker.say(spONE);
    break;
    case 2: CircuitPlayground.speaker.say(spTWO);
    break;
    case 3: CircuitPlayground.speaker.say(spTHREE);
    break;
    case 4: CircuitPlayground.speaker.say(spFOUR);
    break;
    case 5: CircuitPlayground.speaker.say(spFIVE);
    break;
    case 6: CircuitPlayground.speaker.say(spSIX);
    break;
    case 7: CircuitPlayground.speaker.say(spSEVEN);
    break;
    case 8: CircuitPlayground.speaker.say(spEIGHT);
    break;
    case 9: CircuitPlayground.speaker.say(spNINE);
    break;
    case 10: CircuitPlayground.speaker.say(spTEN);
    break;
    case 11: CircuitPlayground.speaker.say(spELEVEN);
    break;
    case 12: CircuitPlayground.speaker.say(spTWELVE);
    break;
    case 13: CircuitPlayground.speaker.say(spTHIRTEEN);
    break;
    case 14: CircuitPlayground.speaker.say(spFOURTEEN);
    break;
    case 15: CircuitPlayground.speaker.say(spFIFTEEN);
    break;
    case 16: CircuitPlayground.speaker.say(spSIXTEEN);
    break;
    case 17: CircuitPlayground.speaker.say(spSEVENTEEN);
    break;
    case 18: CircuitPlayground.speaker.say(spEIGHTEEN);
    break;
    case 19: CircuitPlayground.speaker.say(spNINETEEN);
    break;
    case 20: CircuitPlayground.speaker.say(spTWENTY);
    break;
  }
  gametime=5000;//reset gametime
  score=0;//reset score
  breathing();// play losing animation
}
void win(){//winning function
  CircuitPlayground.clearPixels(); //turn off all lights
  gametime=gametime-250; //reduce the game time length by 250ms
}
void reset(){//reset function
    CircuitPlayground.clearPixels(); //turn off all pixels
    userr = 0; //set the right user selector led to the starting position
    userl = 9; //set the left user selector led to the starting position
}
//setup:
void setup(){
  CircuitPlayground.begin(); //initalize CPX board
  attachInterrupt(digitalPinToInterrupt(5), singlePressl, FALLING); //attach interupts to left pin
  attachInterrupt(digitalPinToInterrupt(4), singlePressr, FALLING); //attach interupts to right pin
}
//loop:
void loop() {
  randomSeed(random()); //randomize where you start in the random number sequence
  tImer.start(gametime, AsyncDelay::MILLIS); //start the global game timer
  randomcolors(); //display random colors on pins
  CircuitPlayground.setPixelColor(userl, 255, 255, 255); //set left selector led at beggining
  CircuitPlayground.setPixelColor(userr, 255, 255, 255); //set right selector led at beggining
  while(!tImer.isExpired()){ //while the timer is still going
    if(lactuation && (userl >= lrandlight)){ // if you push the left button and the left light is not on the pin of the random light yet
      userl--;//advance one position
      CircuitPlayground.setPixelColor(userl+1, 0, 0, 0); //turns selector led off
      CircuitPlayground.setPixelColor(userl, 255, 255, 255); //advances selector led to next position
      lactuation =0; //reset the left button flag
    }
    if(ractuation && (userr <= rrandlight)){ //if you push the right button and the right selector led is less than the random light
      userr++; //advance the selector led
      CircuitPlayground.setPixelColor(userr-1, 0, 0, 0); //set selector led to off
      CircuitPlayground.setPixelColor(userr, 255, 255, 255); //advance selector led position
      ractuation =0; //reset right button interupt
    }
    else if(!(userr <= rrandlight)){ //one way to loose; right selector led goes past random led
      loose(); //run through losing fuction
      break;// break out of while loop
      }
    else if(!(userl >= lrandlight)){ //another way to loose; left sector light is past left random light
      loose(); //run through losing fuction
      break; //break out of while loop
      }
    if(userr==rrandlight && userl==lrandlight){ //how you win; if both selector leds are equal to the random leds
      win(); //run through winning function
      break; //break out of while loop
    }
  }
  while(tImer.isExpired()){ //if the timer is up
    loose(); //you loose
    break; //break out of while loop
  }
  reset(); //the game resets
}
